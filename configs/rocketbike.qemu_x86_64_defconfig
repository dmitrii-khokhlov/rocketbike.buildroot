## configs/rocketbike.qemu_x86_64_defconfig
```kconfig
BR2_x86_64=y

BR2_CCACHE=y
BR2_CCACHE_INITIAL_SETUP="--max-files 0 --max-size 0"

BR2_OPTIMIZE_3=y

BR2_TOOLCHAIN_BUILDROOT_VENDOR="rocketbike"

BR2_TARGET_GENERIC_HOSTNAME="rocketbike"
BR2_TARGET_GENERIC_ISSUE="Welcome to RocketBike"

BR2_ROOTFS_POST_BUILD_SCRIPT="$(BR2_EXTERNAL_ROCKETBIKE_PATH)/board/qemu-x86_64/post-build.sh"
BR2_ROOTFS_POST_IMAGE_SCRIPT="$(BR2_EXTERNAL_ROCKETBIKE_PATH)/board/qemu-x86_64/post-image.sh"

BR2_LINUX_KERNEL=y
BR2_LINUX_KERNEL_USE_CUSTOM_CONFIG=y
BR2_LINUX_KERNEL_CUSTOM_CONFIG_FILE="$(BR2_EXTERNAL_ROCKETBIKE_PATH)/board/qemu-x86_64/linux.config"

# BR2_PACKAGE_IFUPDOWN_SCRIPTS is not set
# BR2_PACKAGE_URANDOM_SCRIPTS is not set

BR2_TARGET_ROOTFS_EXT2=y
# BR2_TARGET_ROOTFS_TAR is not set
```
